PROVIDE(wwdg               = abort);
PROVIDE(pvd                = abort);
PROVIDE(tamper_stamp       = abort);
PROVIDE(rtc_wkup           = abort);
PROVIDE(flash              = abort);
PROVIDE(rcc                = abort);
PROVIDE(exti0              = abort);
PROVIDE(exti1              = abort);
PROVIDE(exti2              = abort);
PROVIDE(exti3              = abort);
PROVIDE(exti4              = abort);
PROVIDE(dma1_channel1      = abort);
PROVIDE(dma1_channel2      = abort);
PROVIDE(dma1_channel3      = abort);
PROVIDE(dma1_channel4      = abort);
PROVIDE(dma1_channel5      = abort);
PROVIDE(dma1_channel6      = abort);
PROVIDE(dma1_channel7      = abort);
PROVIDE(adc1               = abort);
PROVIDE(exti9_5            = abort);
PROVIDE(tim1_brk_tim15     = abort);
PROVIDE(tim1_up_tim16      = abort);
PROVIDE(tim1_trg_com_tim17 = abort);
PROVIDE(tim1_cc            = abort);
PROVIDE(tim2               = abort);
PROVIDE(tim3               = abort);
PROVIDE(tim4               = abort);
PROVIDE(i2c1_ev            = abort);
PROVIDE(i2c1_er            = abort);
PROVIDE(i2c2_ev            = abort);
PROVIDE(i2c2_er            = abort);
PROVIDE(spi1               = abort);
PROVIDE(spi2               = abort);
PROVIDE(usart1             = abort);
PROVIDE(usart2             = abort);
PROVIDE(usart3             = abort);
PROVIDE(exti15_10          = abort);
PROVIDE(rtc_alarm          = abort);
PROVIDE(cec                = abort);
PROVIDE(tim12              = abort);
PROVIDE(tim13              = abort);
PROVIDE(tim14              = abort);
PROVIDE(fsmc               = abort);
PROVIDE(tim5               = abort);
PROVIDE(spi3               = abort);
PROVIDE(uart4              = abort);
PROVIDE(uart5              = abort);
PROVIDE(tim6_dac           = abort);
PROVIDE(tim7               = abort);
PROVIDE(dma2_channel1      = abort);
PROVIDE(dma2_channel2      = abort);
PROVIDE(dma2_channel3      = abort);
PROVIDE(dma2_channel4_5    = abort);
PROVIDE(dma2_channel5      = abort);
